AUTOSAR XML (schema 00049)
standard types defined: uint8, float, uint16, boolean, double, sint16, sint32, sint64, sint8, uint32, uint64
package /dds
  impl type Cabin_Door_PDIO_FL_t: category=STRUCTURE
    15 x element, all with category=VALUE:
      PDIO_FL_Driver_Door_Switch_State: base-type=uint8
      PDIO_FL_Driver_Door_Unlock_State: base-type=uint8
      PDIO_FL_PwrDrAvailability: base-type=uint8
      PDIO_FL_PwrDrAngle: base-type=float
      PDIO_FL_PwrDrStatus: base-type=uint8
      PDIO_FL_PwrDrSwingActrStatus: base-type=uint8
      PDIO_FL_PwrDrErrorState: base-type=uint8
      PDIO_FL_PwrDrAntiPinchStatus: base-type=uint8
      PDIO_FL_PwrDrAngleSpeed: base-type=float
      PDIO_FL_InsdOpnClsSwStatus: base-type=uint8
      PDIO_FL_OtsdOpnClsSwStatus: base-type=uint8
      PDIO_FL_SleepReady: base-type=uint8
      PDIO_FL_WakeupRequest: base-type=uint8
      PDIO_FL_CinchingStatus: base-type=uint8
      PDIO_FL_ActiveHoldingState: base-type=uint8
package /dds
  impl type Cabin_Seat_PSUIO_DRV_t: category=STRUCTURE
    79 x element, all with category=VALUE:
      Drive_Slide_CurrentPosition: base-type=uint16
      Drive_Recline_CurrentPosition: base-type=uint16
      Drive_Height_CurrentPosition: base-type=uint16
      Drive_Tilt_CurrentPosition: base-type=uint16
      Drive_RelaxTilt_CurrentPosition: base-type=uint16
      Drive_Legrest_CurrentPosition: base-type=uint16
      Drive_Seat_MotorIntegratedMove_FeedbackInitial: base-type=uint8
      Drive_Slide_VirtualLimitReach_State: base-type=uint8
      Drive_Recline_VirtualLimitReach_State: base-type=uint8
      Drive_Tilt_VirtualLimitReach_State: base-type=uint8
      Drive_RelaxTilt_VirtualLimitReach_State: base-type=uint8
      Drive_Height_VirtualLimitReach_State: base-type=uint8
      Drive_Legrest_VirtualLimitReach_State: base-type=uint8
      Drive_Slide_Sensor_ErrorState: base-type=uint8
      Drive_Recline_Sensor_ErrorState: base-type=uint8
      Drive_Tilt_Sensor_ErrorState: base-type=uint8
      Drive_RelaxTilt_Sensor_ErrorState: base-type=uint8
      Drive_Height_Sensor_ErrorState: base-type=uint8
      Drive_Legrest_Sensor_ErrorState: base-type=uint8
      Drive_Slide_EndLimit_ReachState: base-type=uint8
      Drive_Recline_EndLimit_ReachState: base-type=uint8
      Drive_Tilt_EndLimit_ReachState: base-type=uint8
      Drive_RlxTilt_EndLimit_ReachState: base-type=uint8
      Drive_Height_EndLimit_ReachState: base-type=uint8
      Drive_Legrest_EndLimit_ReachState: base-type=uint8
      Drive_UnitAppliedOption: base-type=uint8
      Drive_AllSeat_Motor_FailState: base-type=uint8
      Drive_Slide_MotorMove_State: base-type=uint8
      Drive_Recline_MotorMove_State: base-type=uint8
      Drive_Tilt_MotorMove_State: base-type=uint8
      Drive_RelaxTilt_MotorMove_State: base-type=uint8
      Drive_Height_MotorMove_State: base-type=uint8
      Drive_Legrest_MotorMove_State: base-type=uint8
      Drive_Slide_MotorMove_StateInitial: base-type=uint8
      Drive_Recline_MotorMove_StateInitial: base-type=uint8
      Drive_Tilt_MotorMove_StateInitial: base-type=uint8
      Drive_RelaxTilt_MotorMove_StateInitial: base-type=uint8
      Drive_Height_MotorMove_StateInitial: base-type=uint8
      Drive_Legrest_MotorMove_StateInitial: base-type=uint8
      Drive_Slide_MotorVirtualLimitSet_State: base-type=uint8
      Drive_Recline_MotorVirtualLimitSet_State: base-type=uint8
      Drive_Tilt_MotorVirtualLimitSet_State: base-type=uint8
      Drive_RelaxTilt_MotorVirtualLimitSet_State: base-type=uint8
      Drive_Height_MotorVirtualLimitSet_State: base-type=uint8
      Drive_Legrest_MotorVirtualLimitSet_State: base-type=uint8
      Drive_Seat_EasyAccess_Option: base-type=uint8
      Drive_Slide_ForwardMotor_Output: base-type=uint8
      Drive_Slide_BackwardMotor_Output: base-type=uint8
      Drive_Recline_ForwardMotor_Output: base-type=uint8
      Drive_Recline_BackwardMotor_Output: base-type=uint8
      Drive_Tilt_ForwardMotor_Output: base-type=uint8
      Drive_Tilt_BackwardMotor_Output: base-type=uint8
      Drive_RlxTilt_ForwardMotor_Output: base-type=uint8
      Drive_RlxTilt_BackwardMotor_Output: base-type=uint8
      Drive_Height_ForwardMotor_Output: base-type=uint8
      Drive_Height_BackwardMotor_Output: base-type=uint8
      Drive_Legrest_ForwardMotor_Output: base-type=uint8
      Drive_Legrest_BackwardMotor_Output: base-type=uint8
      DPSS_StSldFwdMvBtn_PSUIO_DRV: base-type=uint8
      DPSS_StSldBwdMvBtn_PSUIO_DRV: base-type=uint8
      DPSS_StRclFwdMvBtn_PSUIO_DRV: base-type=uint8
      DPSS_StRclBwdMvBtn_PSUIO_DRV: base-type=uint8
      DPSS_StTltUpMvBtn_PSUIO_DRV: base-type=uint8
      DPSS_StTltDnMvBtn_PSUIO_DRV: base-type=uint8
      DPSS_StRlxTltUpMvBtn_PSUIO_DRV: base-type=uint8
      DPSS_StRlxTltDnMvBtn_PSUIO_DRV: base-type=uint8
      DPSS_StHgtUpMvBtn_PSUIO_DRV: base-type=uint8
      DPSS_StHgtDnMvBtn_PSUIO_DRV: base-type=uint8
      DPSS_StLegUpMvBtn_PSUIO_DRV: base-type=uint8
      DPSS_StLegDnMvBtn_PSUIO_DRV: base-type=uint8
      DPSS_StRlxModeBtn_PSUIO_DRV: base-type=uint8
      DPSS_StRlxReturnBtn_PSUIO_DRV: base-type=uint8
      Drive_PSU_Slide_Fail_State_PSUIO_DRV: base-type=uint8
      Drive_PSU_Recline_Fail_State_PSUIO_DRV: base-type=uint8
      Drive_PSU_Tilt_Fail_State_PSUIO_DRV: base-type=uint8
      Drive_PSU_RlxTilt_Fail_State_PSUIO_DRV: base-type=uint8
      Drive_PSU_Height_Fail_State_PSUIO_DRV: base-type=uint8
      Drive_PSU_Legrest_Fail_State_PSUIO_DRV: base-type=uint8
      PSUIO_DRV_SleepReady: base-type=uint8
package /dds
  impl type GCS_LEFT_2_PDIO_FL_t: category=STRUCTURE
    17 x element, all with category=VALUE:
      PwrDrOpnClsCmd_PDIO_FL: base-type=uint8
      PwrDrSnsrStatus_RODS_FL_PDIO_FL: base-type=uint8
      PwrDrSnsrStopAngle_RODS_FL_PDIO_FL: base-type=float
      PwrDrSnsrStopRequest_RODS_FL_PDIO_FL: base-type=uint8
      ACU_CrshActvSta_PDIO_FL: base-type=uint8
      ACU_CrshTyp_PDIO_FL: base-type=uint16
      Door_LockUnlockCmd_PDIO_FL: base-type=uint8
      IMU_LatAccelSigSta_PDIO_FL: base-type=uint8
      IMU_LongAccelSigSta_PDIO_FL: base-type=uint8
      IMU_LatAccelVal_PDIO_FL: base-type=float
      IMU_LongAccelVal_PDIO_FL: base-type=float
      VehicleSpeedState_PDIO_FL: base-type=uint16
      VCU_GearPosSta_PDIO_FL: base-type=uint8
      PwrDrOpnAngVal_PDIO_FL: base-type=float
      SleepRequestTo_PDIO_FL: base-type=uint8
      SleepCommandTo_PDIO_FL: base-type=uint8
      VehiclePowerState_PDIO_FL: base-type=uint8
package /dds
  impl type GCS_LEFT_2_PSUIO_DRV_t: category=STRUCTURE
    19 x element, all with category=VALUE:
      PSeat_DrvInitializationPlayCmd_PSUIO_DRV: base-type=uint8
      PSeat_DrvSlideManualPlayCmd_PSUIO_DRV: base-type=uint8
      PSeat_DrvReclineManualPlayCmd_PSUIO_DRV: base-type=uint8
      PSeat_DrvTiltManualPlayCmd_PSUIO_DRV: base-type=uint8
      PSeat_DrvRlxTiltManualPlayCmd_PSUIO_DRV: base-type=uint8
      PSeat_DrvHeightManualPlayCmd_PSUIO_DRV: base-type=uint8
      PSeat_DrvLegrestManualPlayCmd_PSUIO_DRV: base-type=uint8
      Pseat_DrvAutoCmdTargetPos_PSUIO_DRV: base-type=uint8
      Pseat_DrvAutoCmdTargetPos_Percentage_PSUIO_DRV: base-type=uint8
      Driver_Recline_TargetPlayCmd_PSUIO_DRV: base-type=uint16
      Driver_Slide_TargetPlayCmd_PSUIO_DRV: base-type=uint16
      Driver_Tilt_TargetPlayCmd_PSUIO_DRV: base-type=uint16
      Driver_RlxTilt_TargetPlayCmd_PSUIO_DRV: base-type=uint16
      Driver_Height_TargetPlayCmd_PSUIO_DRV: base-type=uint16
      Driver_Legrest_TargetPlayCmd_PSUIO_DRV: base-type=uint16
      DriveTypeOption_PSUIO_DRV: base-type=uint8
      ICU_PowerAutoCutModSta_PSUIO_DRV: base-type=uint8
      SleepRequestTo_PSUIO_DRV: base-type=uint8
      VehicePowerState_PSUIO_DRV: base-type=uint8
